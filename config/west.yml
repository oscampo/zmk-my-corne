## config/west.yml
```yaml
manifest:
  remotes:
    - name: zmkfirmware
      url-base: https://github.com/zmkfirmware
      # Additional modules containing boards/shields/custom code can be listed here as well.
      # See:
      # - https://zmk.dev/docs/features/modules
      # - https://docs.zephyrproject.org/3.5.0/develop/west/manifest.html#projects
    - name: urob
      url-base: https://github.com/urob
    - name: oscampo
      url-base: https://github.com/oscampo
  projects:
    - name: eyelash_corne
      url: https://github.com/a741725193/zmk-new_corne
      revision: main
    - name: zmk
      remote: zmkfirmware
      revision: v0.3.0
      import: app/west.yml
    - name: zmk-unicode
      remote: urob
      revision: main
    # Display feature logic (custom_status_screen.c) lives here now, not in
    # config/ - see zmk-companion's own zephyr/module.yml for how it wires in
    # via CONFIG_ZMK_COMPANION_DISPLAY.
    - name: zmk-companion
      remote: oscampo
      revision: main
  self:
    path: config
```
